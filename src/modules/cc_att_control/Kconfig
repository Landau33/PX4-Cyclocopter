## src/modules/cc_att_control/Kconfig
```kconfig
menuconfig MODULES_CC_ATT_CONTROL
	bool "cc_att_control"
	default n
	---help---
		Enable support for cc_att_control

menuconfig USER_CC_ATT_CONTROL
	bool "cc_att_control running as userspace module"
	default n
	depends on BOARD_PROTECTED && MODULES_CC_ATT_CONTROL
	---help---
		Put cc_att_control in userspace memory
```

## src/modules/cc_pos_control/Kconfig
```kconfig
menuconfig MODULES_CC_POS_CONTROL
	bool "cc_pos_control"
	default n
	---help---
		Enable support for cc_pos_control

menuconfig USER_CC_POS_CONTROL
	bool "cc_pos_control running as userspace module"
	default y
	depends on BOARD_PROTECTED && MODULES_CC_POS_CONTROL
	---help---
		Put cc_pos_control in userspace memory
```

## src/modules/cc_rate_control/Kconfig
```kconfig
menuconfig MODULES_CC_RATE_CONTROL
	bool "cc_rate_control"
	default n
	---help---
		Enable support for cc_rate_control

menuconfig USER_CC_RATE_CONTROL
	bool "cc_rate_control running as userspace module"
	default n
	depends on BOARD_PROTECTED && MODULES_CC_RATE_CONTROL
	---help---
		Put cc_rate_control in userspace memory
```
